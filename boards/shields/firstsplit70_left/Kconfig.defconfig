## boards/shields/firstsplit70_left/Kconfig.defconfig
```kconfig
if SHIELD_FIRSTSPLIT70_LEFT

config ZMK_KEYBOARD_NAME
	default "FirstSplit70"

config ZMK_SPLIT_ROLE_CENTRAL
	default y

config ZMK_SPLIT_BLE_CENTRAL_PERIPHERALS
	default 1

endif

if SHIELD_FIRSTSPLIT70_LEFT || SHIELD_FIRSTSPLIT70_RIGHT

config ZMK_SPLIT
	default y

endif
```

## boards/shields/firstsplit70_left/Kconfig.shield
```kconfig
config SHIELD_FIRSTSPLIT70_LEFT
	def_bool $(shields_list_contains,firstsplit70_left)
```

## boards/shields/firstsplit70_right/Kconfig.defconfig
```kconfig
if SHIELD_FIRSTSPLIT70_RIGHT

config ZMK_KEYBOARD_NAME
	default "FirstSplit70"

endif
```

## boards/shields/firstsplit70_right/Kconfig.shield
```kconfig
config SHIELD_FIRSTSPLIT70_RIGHT
	def_bool $(shields_list_contains,firstsplit70_right)
```

## config/boards/xiao_ble.conf
```kconfig
# BLE Configuration for split keyboard
CONFIG_ZMK_BLE=y
CONFIG_ZMK_SPLIT_BLE=y

# Bluetooth power
CONFIG_ZMK_BLE_TX_POWER_DBM=8

# Battery percentage
CONFIG_ZMK_BATTERY_REPORT_INTERVAL=30

# USB Configuration (when wired)
CONFIG_ZMK_USB=y
CONFIG_ZMK_USB_INIT_PRIORITY=50
```
